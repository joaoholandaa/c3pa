#include <Servo.h>
#include <CuteBuzzerSounds.h>
#include <Wire.h> 
#include <Adafruit_GFX.h> 
#include <Adafruit_SSD1306.h>

#define NO_OF_SERVOS 2

Servo servo1;
Servo servo2;
Servo servo3;
Servo servo4;

Servo servo_array[NO_OF_SERVOS] = {servo1, servo2};

int servo_pins[NO_OF_SERVOS] = {3,5};
int angle_init[NO_OF_SERVOS]  = {90, 90}; 
int sequencia[32] = {};
int botoes[4] = {10, 11, 12, 13};
int leds[4] = {0, 1, 2, 4};
int tons[4] = {262, 294, 330, 349};
const int vibracall = 8;
int rodada = 0;
int passo = 0;
bool game_over = false;

// 'frame_0_delay-0', 48x48px
const unsigned char epd_bitmap_frame_0_delay_0 [] PROGMEM = {
	0x00, 0x00, 0x00, 0x00, 0x00, 0x00, 0x00, 0x00, 0x00, 0x00, 0x00, 0x00, 0x00, 0x00, 0x60, 0x00, 
	0x00, 0x00, 0x00, 0x01, 0xff, 0x80, 0x7f, 0x80, 0x00, 0x07, 0xff, 0xf9, 0xff, 0xc0, 0x00, 0x3f, 
	0xfd, 0xff, 0xff, 0xf0, 0x00, 0x7f, 0xff, 0xf7, 0xff, 0xf0, 0x00, 0xff, 0xff, 0xf7, 0xff, 0xf0, 
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	0x78, 0x00, 0x00, 0x00, 0x00, 0x00, 0x40, 0x00, 0x00, 0x00, 0x00, 0x00, 0x00, 0x00, 0x00, 0x00
};
// 'frame_1_delay-0', 48x48px
const unsigned char epd_bitmap_frame_1_delay_0 [] PROGMEM = {
	0x00, 0x00, 0x00, 0x00, 0x00, 0x00, 0x00, 0x00, 0x00, 0x00, 0x00, 0x00, 0x00, 0x00, 0x00, 0x00, 
	0x00, 0x00, 0x00, 0x00, 0xe0, 0x00, 0x03, 0x80, 0x00, 0x03, 0xff, 0xf0, 0x7d, 0xe0, 0x00, 0x5b, 
	0xff, 0xf8, 0xdb, 0x70, 0x00, 0xff, 0xfd, 0xff, 0xbf, 0x70, 0x01, 0xff, 0xef, 0x7f, 0xfe, 0xf0, 
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	0x3c, 0x00, 0x00, 0x00, 0x00, 0x00, 0x18, 0x00, 0x00, 0x00, 0x00, 0x00, 0x00, 0x00, 0x00, 0x00
};

// 'frame_2_delay-0', 48x48px
const unsigned char epd_bitmap_frame_2_delay_0 [] PROGMEM = {
	0x00, 0x00, 0x00, 0x00, 0x00, 0x00, 0x00, 0x00, 0x00, 0x00, 0x00, 0x00, 0x00, 0x00, 0x00, 0x00, 
	0x00, 0x00, 0x00, 0x00, 0x00, 0xf0, 0x3f, 0x80, 0x00, 0x1f, 0x91, 0xfc, 0x7f, 0xc0, 0x00, 0x3d, 
	0xff, 0xff, 0xdf, 0xe0, 0x00, 0x7f, 0xfb, 0xff, 0xff, 0xf0, 0x00, 0xff, 0xff, 0xff, 0xff, 0xf8, 
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	0x78, 0x00, 0x00, 0x00, 0x00, 0x00, 0x00, 0x00, 0x00, 0x00, 0x00, 0x00, 0x00, 0x00, 0x00, 0x00
};

const int epd_bitmap_allArray_LEN = 3;
const unsigned char* epd_bitmap_allArray[3] = {
	epd_bitmap_frame_0_delay_0,
	epd_bitmap_frame_1_delay_0,
  epd_bitmap_frame_2_delay_0
};

Adafruit_SSD1306 display = Adafruit_SSD1306();

void setup() {
  pinMode(0, OUTPUT);
  pinMode(1, OUTPUT);
  pinMode(2, OUTPUT);
  pinMode(4, OUTPUT);
  pinMode(7, OUTPUT);
  pinMode(10, INPUT);
  pinMode(11, INPUT);
  pinMode(12, INPUT);
  pinMode(13, INPUT);

  pinMode(vibracall, OUTPUT);

  for(int i = 0; i < NO_OF_SERVOS; i++){
    pinMode(servo_pins[i], OUTPUT); 
    servo_array[i].attach(servo_pins[i]); 
    delay(50);
    servo_array[i].write(angle_init[i]);    
    delay(50);
  }

  Wire.begin();
  display.begin(SSD1306_SWITCHCAPVCC, 0x3C);
  display.setTextColor(WHITE); 
  display.setTextSize(1,2);

  cute.init(7);

  instrucoesLogo();
}

void loop() {
  proximaRodada();
  reproduzirSequencia();
  aguardarJogador();
  if (game_over == true) {
    sequencia[32] = {};
    rodada = 0;
    passo = 0;
    cute.play(S_SAD);
    digitalWrite(vibracall, HIGH);
    delay(2000);
    digitalWrite(vibracall, LOW);
    game_over = false;
  }
  else{
    cute.play(S_HAPPY_SHORT);
    digitalWrite(vibracall, HIGH);
    delay(500);
    digitalWrite(vibracall, LOW);
  }
  delay(1000);
}

void proximaRodada() {
  randomSeed(analogRead(A0));
  int sorteio = random(4);
  sequencia[rodada] = sorteio;
  rodada = rodada + 1;
}

void reproduzirSequencia() {
  for (int i = 0; i < rodada; i++) {
    tone(7, tons[sequencia[i]]);
    digitalWrite(leds[sequencia[i]], HIGH);
    switch(sequencia[i]) {
      case 0:
        servo_array[0].write(0);
        break;
      case 1:
        servo_array[0].write(180);
        break;
      case 2:
        servo_array[1].write(0);
        break;
      case 3:
        servo_array[1].write(180);
        break;
      default:
        ;
    }
    delay(500);
    noTone(7);
    digitalWrite(leds[sequencia[i]], LOW);
    switch(sequencia[i]) {
      case 0:
        servo_array[0].write(90);
        break;
      case 1:
        servo_array[0].write(90);
        break;
      case 2:
        servo_array[1].write(90);
        break;
      case 3:
        servo_array[1].write(90);
        break;
      default:
        ;
    }
    delay(500);
  }
}

void aguardarJogador() {
  int botao_pressionado = 0;
  for (int i = 0; i < rodada; i++) {
    bool jogada_efetuada = false;
    while (!jogada_efetuada) {
      for (int i = 0; i <= 3; i++) {
        if (digitalRead(botoes[i]) == HIGH) {
          botao_pressionado = i;
          tone(7, tons[i]);
          digitalWrite(leds[i], HIGH);
          delay(300);
          digitalWrite(leds[i], LOW);
          noTone(7);
          jogada_efetuada = true;
        }
      }
    }

    if (sequencia[passo] != botao_pressionado) {
      for (int i = 0; i <= 3; i++) {
        tone (7, 70);
        digitalWrite(leds[i], HIGH);
        delay(100);
        digitalWrite(leds[i], LOW);
        noTone(7);
      }
      game_over = true;
      break;
    }
    passo = passo + 1;
  }
  passo = 0;
}

void instrucoesLogo() {
  display.setCursor(10,5);
  display.print("OLA :)"); 
  display.display();
  cute.play(S_HAPPY);
  digitalWrite(vibracall, HIGH);
  delay(1000); 
  digitalWrite(vibracall, LOW);
  display.clearDisplay(); 
  display.setCursor(10,5); 
  display.print("Me chamo Aurora"); 
  display.display(); 
  cute.play(S_HAPPY);
  digitalWrite(vibracall, HIGH);
  delay(1000); 
  digitalWrite(vibracall, LOW);
  display.clearDisplay(); 
  display.setCursor(10,5); 
  display.print("um jogo de memoria"); 
  display.display(); 
  cute.play(S_HAPPY);
  digitalWrite(vibracall, HIGH);
  delay(1000);
  digitalWrite(vibracall, LOW);
  display.clearDisplay(); 
  display.setCursor(10,5); 
  display.print("coloque suas maos"); 
  display.display(); 
  cute.play(S_HAPPY);
  digitalWrite(vibracall, HIGH);
  delay(1000); 
  digitalWrite(vibracall, LOW);
  display.clearDisplay(); 
  display.setCursor(10,5); 
  display.print("sobre a parte"); 
  display.display();
  cute.play(S_HAPPY);
  digitalWrite(vibracall, HIGH);
  delay(1000);
  digitalWrite(vibracall, LOW);
  display.clearDisplay();
  display.setCursor(10,5); 
  display.print("superior da caixa"); 
  display.display(); 
  cute.play(S_HAPPY);
  digitalWrite(vibracall, HIGH);
  delay(1000); 
  digitalWrite(vibracall, LOW);
  display.clearDisplay(); 
  display.setCursor(10,5); 
  display.print("Tente memorizar o"); 
  display.display();
  cute.play(S_HAPPY);
  digitalWrite(vibracall, HIGH);
  delay(1000);
  digitalWrite(vibracall, LOW);
  display.clearDisplay();
  display.setCursor(10,5); 
  display.print("maximo de sequencias"); 
  display.display();
  cute.play(S_HAPPY);
  digitalWrite(vibracall, HIGH);
  delay(1000);
  digitalWrite(vibracall, LOW);
  display.clearDisplay();
  display.setCursor(10,5); 
  display.print("divirta-se"); 
  display.display();
  cute.play(S_HAPPY);
  digitalWrite(vibracall, HIGH);
  delay(1000);
  digitalWrite(vibracall, LOW);
  display.clearDisplay();
  int i = 0;
  for (i = 0; i < epd_bitmap_allArray_LEN; i++)
  {
    display.drawBitmap(0, 0,  epd_bitmap_allArray[i] , 48, 48, WHITE);
    display.display();
    delay(60);
    display.clearDisplay();

    delay(1);
  }
}